## Kconfig
```kconfig
config MONA2_LAYER_NOTIFIER
    bool "Send the active layer state to the host over Raw HID"
    depends on !ZMK_SPLIT || ZMK_SPLIT_ROLE_CENTRAL
    default y if RAW_HID
    help
      有効レイヤーが変わるたびに、その状態を Raw HID でホストへ送る (moNa2 Studio のレイヤーオーバーレイ用)。
      分割キーボードではセントラル (右手) のみで有効。
```

## config/west.yml
```yaml
manifest:
  remotes:
    - name: zmkfirmware
      url-base: https://github.com/zmkfirmware
    - name: sayu-hub
      url-base: https://github.com/sayu-hub
    - name: badjeff    # <-- PMW3610
      url-base: https://github.com/badjeff
    # - name: sekigon-gonnoc  # <-- PAW3222
    #   url-base: https://github.com/sekigon-gonnoc
    - name: caksoylar  # <-- RGB LED
      url-base: https://github.com/caksoylar
    - name: zettaface  # <-- Input Processor Keybind
      url-base: https://github.com/zettaface
    - name: zzeneg     # <-- Raw HID (レイヤーオーバーレイ用)
      url-base: https://github.com/zzeneg
  projects:
    - name: zmk
      remote: zmkfirmware
      revision: v0.3-branch
      import: app/west.yml
    - name: zmk-pmw3610-driver
      remote: badjeff
      revision: zmk-0.3
    # - name: zmk-driver-paw3222
    #   remote: sekigon-gonnoc
    #   revision: main
    - name: zmk-rgbled-widget
      remote: caksoylar
      revision: v0.3-branch
    - name: zmk-input-processor-keybind
      remote: zettaface
      revision: main
    - name: zmk-raw-hid
      remote: zzeneg
      revision: 6a37765dfab6197292e7a9f47305dcf87386d56a  # 2026-08-24 main
  self:
    path: config
```
